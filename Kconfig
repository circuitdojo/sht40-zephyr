## driver/Kconfig
```kconfig
#
# Copyright (c) 2021 Circuit Dojo LLC
#

menuconfig SHT40
	bool "SHT40 Temperature and Humidity Sensor"
	depends on I2C
	help
	  Enable driver for SHT40 temperature/humidity sensor.

if SHT40

config SHT40_DRV_NAME
	string "Sensirion SHT40 Driver's name"
	default "SHT40"
	help
	  This option sets the driver name

endif # SHT40
```

## dts/bindings/sensirion,sht40.yaml
```yaml
#
# Copyright (c) 2021 Circuit Dojo LLC
#

description: Sensirion SHT40 Temp/Humidity Sensor

compatible: "sensirion,sht40"

include: i2c-device.yaml
```
